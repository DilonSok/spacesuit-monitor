## CMakeLists.txt
```
cmake_minimum_required(VERSION 3.20.0)

find_package(Zephyr REQUIRED HINTS $ENV{ZEPHYR_BASE})
project(spacesuit_monitor)

target_include_directories(app PRIVATE include)

target_sources(app PRIVATE
  src/main.c
  src/app/app_init.c
  src/app/app_ipc.c
  src/core/suit_state.c
  src/drivers/temp_sensor.c
  src/drivers/battery_gauge.c
)
```

## prj.conf
```kconfig
CONFIG_MAIN_STACK_SIZE=2048

CONFIG_PRINTK=y
CONFIG_LOG=y

CONFIG_SYS_CLOCK_EXISTS=y
CONFIG_TIMESLICING=y
```

## src/main.c
```c
#include <zephyr/kernel.h>
#include <zephyr/sys/printk.h>

#include "app/app_init.h"

int main(void)
{
    printk("Space Suit Monitor boot\n");

    app_ctx_t ctx;
    int rc = app_init(&ctx);
    if (rc != 0) {
        printk("app_init failed: %d\n", rc);
        while (1) { k_sleep(K_SECONDS(1)); }
    }

    printk("app_init OK\n");

    while (1) {
        k_sleep(K_SECONDS(1));
    }
}
```
